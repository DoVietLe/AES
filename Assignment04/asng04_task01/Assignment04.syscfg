/**
 * @cliArgs --board "/ti/boards/CC1352R1_LAUNCHXL" --product "simplelink_cc13x2_26x2_sdk@4.30.00.54"
 * @versions {"data":"2020090214","timestamp":"2020090214","tool":"1.6.0+1543","templates":"2020090214"}
 */

/**
 * Import the modules used in this configuration.
 */
const ADC    = scripting.addModule("/ti/drivers/ADC", {}, false);
const ADC1   = ADC.addInstance();
const GPIO   = scripting.addModule("/ti/drivers/GPIO");
const GPIO1  = GPIO.addInstance();
const GPIO2  = GPIO.addInstance();
const PWM    = scripting.addModule("/ti/drivers/PWM", {}, false);
const PWM1   = PWM.addInstance();
const RTOS   = scripting.addModule("/ti/drivers/RTOS");
const Timer  = scripting.addModule("/ti/drivers/Timer");
const Timer1 = Timer.addInstance();
const UART   = scripting.addModule("/ti/drivers/UART", {}, false);
const UART1  = UART.addInstance();

/**
 * Write custom configuration values to the imported modules.
 */
ADC1.$name                = "CONFIG_ADC_0";
ADC1.adc.$assign          = "ADC0";
ADC1.adc.adcPin.$assign   = "boosterpack.2";
ADC1.adcPinInstance.$name = "CONFIG_PIN_2";

GPIO1.$hardware         = system.deviceData.board.components.LED_RED;
GPIO1.$name             = "CONFIG_GPIO_LED_0";
GPIO1.pinInstance.$name = "CONFIG_PIN_0";

GPIO2.$name             = "CONFIG_GPIO_0";
GPIO2.$hardware         = system.deviceData.board.components.MX25R8035F.subComponents.SELECT;
GPIO2.pinInstance.$name = "CONFIG_PIN_4";

PWM1.$name                            = "CONFIG_PWM_0";
PWM1.$hardware                        = system.deviceData.board.components.LED_GREEN;
PWM1.timerObject.$name                = "CONFIG_GPTIMER_1";
PWM1.timerObject.pwmPinInstance.$name = "CONFIG_PIN_3";

const CCFG              = scripting.addModule("/ti/devices/CCFG", {}, false);
CCFG.ccfgTemplate.$name = "ti_devices_CCFGTemplate0";

Timer1.timerType           = "32 Bits";
Timer1.$name               = "CONFIG_TIMER";
Timer1.timerInstance.$name = "CONFIG_GPTIMER_0";

UART1.$name               = "CONFIG_UART_0";
UART1.dataDirection       = "Send Only";
UART1.$hardware           = system.deviceData.board.components.XDS110UART;
UART1.txPinInstance.$name = "CONFIG_PIN_1";

/**
 * Pinmux solution for unlocked pins/peripherals. This ensures that minor changes to the automatic solver in a future
 * version of the tool will not impact the pinmux you originally saw.  These lines can be completely deleted in order to
 * re-solve from scratch.
 */
GPIO1.gpioPin.$suggestSolution                 = "boosterpack.39";
GPIO2.gpioPin.$suggestSolution                 = "boosterpack.38";
PWM1.timerObject.timer.$suggestSolution        = "GPTM0";
PWM1.timerObject.timer.pwmPin.$suggestSolution = "boosterpack.40";
Timer1.timerInstance.timer.$suggestSolution    = "GPTM1";
UART1.uart.$suggestSolution                    = "UART0";
UART1.uart.txPin.$suggestSolution              = "boosterpack.4";
